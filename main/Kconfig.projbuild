## main/Kconfig.projbuild
```kconfig
menu "Example Configuration"

    config BROKER_URI
        string "Broker URL"
        default "mqtts://abc123.s1.eu.hivemq.cloud:8883"
        help
            URL of an mqtt broker which this example connects to.

    config MQTT_AUTH_USERNAME
        string "MQTT Username"
        default "hot-seat"
        help
            MQTT username for authentication.

    config MQTT_AUTH_PASSWORD
        string "MQTT Password"
        default "hot-seat-password"
        help
            MQTT password for authentication.

    config EXAMPLE_WIFI_SSID
        string "WiFi SSID"
        default "your-ssid"
        help
            SSID of the WiFi network to connect to.

    config EXAMPLE_WIFI_PASSWORD
        string "WiFi Password"
        default "your-password"
        help
            Password of the WiFi network to connect to.

endmenu
```
